## src/configs/koros_defconfig
```kconfig
BR2_x86_64=y
BR2_TOOLCHAIN_BUILDROOT=y

# Init system
BR2_INIT_SYSTEMD=y

# Boot
BR2_TARGET_GRUB2=y
BR2_TARGET_ROOTFS_ISO9660=y

# External tree
BR2_EXTERNAL="../external"

# Packages
BR2_PACKAGE_ZSH=y
BR2_PACKAGE_OPENSSH=y
BR2_PACKAGE_YOINK=y

# Kernel
BR2_LINUX_KERNEL=y
BR2_LINUX_KERNEL_USE_CUSTOM_CONFIG=y
BR2_LINUX_KERNEL_CUSTOM_CONFIG_FILE="board/x86_64/linux.config"
```
